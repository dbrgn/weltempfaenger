## rpi-image/buildroot-defconfig
```kconfig
# Use CCache
BR2_CCACHE=y
BR2_CCACHE_USE_BASEDIR=y

# Support packages that might also be provided by busybox
BR2_PACKAGE_BUSYBOX_SHOW_OTHERS=y

# Hostname
BR2_TARGET_GENERIC_HOSTNAME="weltempfaenger"
BR2_TARGET_GENERIC_ROOT_PASSWD="weltempfaenger"

# Timezone
BR2_TARGET_TZ_INFO=y
BR2_TARGET_TZ_ZONELIST="default"
BR2_TARGET_LOCALTIME="Europe/Zurich"

# Overlays
BR2_ROOTFS_OVERLAY="board/weltempfaenger/rootfs-overlay/"
BR2_ROOTFS_POST_BUILD_SCRIPT="board/weltempfaenger/post-build.sh"
BR2_ROOTFS_POST_FAKEROOT_SCRIPT=""
BR2_ROOTFS_POST_IMAGE_SCRIPT="board/weltempfaenger/post-image.sh"
BR2_ROOTFS_POST_SCRIPT_ARGS=""

# RPI
BR2_ROOTFS_DEVICE_CREATION_DYNAMIC_MDEV=y
BR2_PACKAGE_RPI_FIRMWARE=y
BR2_PACKAGE_RPI_FIRMWARE_CONFIG_FILE="board/weltempfaenger/config.txt"

# WiFi
BR2_PACKAGE_RPI_WIFI_FIRMWARE=y
BR2_PACKAGE_WIRELESS_TOOLS=y
BR2_PACKAGE_WIRELESS_REGDB=y
BR2_PACKAGE_WPA_SUPPLICANT=y
BR2_PACKAGE_WPA_SUPPLICANT_NL80211=y
BR2_PACKAGE_WPA_SUPPLICANT_CLI=y
BR2_PACKAGE_WPA_SUPPLICANT_PASSPHRASE=y

# Root FS
BR2_TARGET_ROOTFS_EXT2_LABEL="rootfs"
BR2_TARGET_ROOTFS_EXT2_SIZE="512M"

# Toolchain
BR2_TOOLCHAIN_BUILDROOT_WCHAR=y
BR2_USE_WCHAR=y
BR2_USE_MMU=y

# Shell
BR2_PACKAGE_BASH=y
BR2_PACKAGE_READLINE=y
BR2_SYSTEM_BIN_SH_BASH=y
BR2_SYSTEM_BIN_SH="bash"

# System utilities
BR2_PACKAGE_KBD=y

# Audio: alsa
BR2_PACKAGE_ALSA_UTILS=y
BR2_PACKAGE_ALSA_UTILS_ALSACTL=y
BR2_PACKAGE_ALSA_UTILS_ALSAMIXER=y
BR2_PACKAGE_ALSA_UTILS_APLAY=y
BR2_PACKAGE_ALSA_UTILS_SPEAKER_TEST=y

# Multimedia: ffmpeg
BR2_PACKAGE_FFMPEG_ARCH_SUPPORTS=y
BR2_PACKAGE_FFMPEG=y
BR2_PACKAGE_FFMPEG_FFMPEG=y
BR2_PACKAGE_FFMPEG_FFPLAY=y
BR2_PACKAGE_FFMPEG_SWSCALE=y
BR2_PACKAGE_FFMPEG_ENCODERS=""
BR2_PACKAGE_FFMPEG_DECODERS="mp3 flac vorbis"
BR2_PACKAGE_FFMPEG_MUXERS=""
BR2_PACKAGE_FFMPEG_DEMUXERS="mp3 flac ogg"
BR2_PACKAGE_FFMPEG_PARSERS=""
BR2_PACKAGE_FFMPEG_BSFS="mp3_header_decompress"
BR2_PACKAGE_FFMPEG_PROTOCOLS="http https icecast"
BR2_PACKAGE_FFMPEG_FILTERS="aresample"
BR2_PACKAGE_FFMPEG_INDEVS=y
BR2_PACKAGE_FFMPEG_OUTDEVS=y
BR2_PACKAGE_FFMPEG_EXTRACONF=""

# Other packages
BR2_PACKAGE_I2C_TOOLS=y
BR2_PACKAGE_VIM=y
BR2_PACKAGE_VIM_RUNTIME=y
```
